## drivers/media/dvb/idl4k/Kconfig
```kconfig
config DVB_IDL4K
	tristate "Inverto IDL4K DVB-S/S2 adapters"
	depends on DVB_CORE && DVB_TANGO_PTI && I2C
	select DVB_STV090x
	select DVB_STV6120
	select DVB_LNBP21
	help
	  The four satellite inputs of the IDL4K SAT>IP server: one DVB
	  adapter per input, with STV0900 demodulators, STV6120 tuners,
	  LNBH24 LNB supplies and the demux on the TANGO transport
	  processor.
```

## drivers/media/dvb/tango/Kconfig
```kconfig
config DVB_TANGO_PTI
	tristate "STx7108 TANGO transport processor and TS inputs"
	depends on CPU_SUBTYPE_STX7108
	select FW_LOADER
	help
	  Live TS inputs (STFE) and hardware PID filtering on the TANGO
	  transport processor of the STx7108.  The processor runs the
	  Transport Engine firmware, loaded with request_firmware().

	  The DVB adapters are created by the board driver on top of it.
```
